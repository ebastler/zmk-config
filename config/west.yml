## config/west.yml
```yaml
manifest:
  remotes:
    - name: zmkfirmware
      url-base: https://github.com/zmkfirmware
    - name: ebastler
      url-base: https://github.com/ebastler
  projects:
    - name: zmk
      remote: zmkfirmware
      revision: main
      import: app/west.yml
    - name: zmk-module-cornholius
      remote: ebastler
      revision: main
  self:
    path: config
```
