## boards/arm/cornholius_a/Kconfig.defconfig
```kconfig
# Copyright (c) 2020 The ZMK Contributors
# SPDX-License-Identifier: MIT

if BOARD_CORNHOLIUS_A

config ZMK_KEYBOARD_NAME
	default "cornholius"

if USB

config USB_NRFX
	default y

config USB_DEVICE_STACK
	default y

endif # USB

config BT_CTLR
	default BT

config ZMK_BLE
	default y

config ZMK_USB
	default y

config I2C
	default y

config MAX17048
	default y

endif # BOARD_CORNHOLIUS_A
```

## config/altar/Kconfig.defconfig
```kconfig
# isometria75 rev2 board configuration

# Copyright (c) 2020 The ZMK Contributors
# SPDX-License-Identifier: MIT

if BOARD_ALTAR_REV1

config ZMK_KEYBOARD_NAME
	default "Altar"

if USB

config USB_NRFX
	default y

config USB_DEVICE_STACK
	default y

endif # USB

config BT_CTLR
	default BT

config ZMK_BLE
	default y

config ZMK_USB
	default y

config ZMK_BATTERY_VOLTAGE_DIVIDER
	default y

endif # BOARD_ALTAR_REV1
```

## config/boards/arm/altar-i-iso/Kconfig.board
```kconfig
# Copyright (c) 2020 The ZMK Contributors
# SPDX-License-Identifier: MIT

config BOARD_ALTAR_I_UK
	bool "Altar I"
	depends on SOC_NRF52840_QIAA
```

## config/boards/arm/altar-i-us/Kconfig.board
```kconfig
# Copyright (c) 2020 The ZMK Contributors
# SPDX-License-Identifier: MIT

config BOARD_ALTAR_I_US
	bool "Altar I Keyboard"
	depends on SOC_NRF52840_QIAA
```

## config/boards/arm/altar/Kconfig.board
```kconfig
# Copyright (c) 2020 The ZMK Contributors
# SPDX-License-Identifier: MIT

config BOARD_ALTAR
	bool "Altar"
	depends on SOC_NRF52840_QIAA
```

## config/boards/arm/cornholius_a/Kconfig.board
```kconfig
# Copyright (c) 2020 The ZMK Contributors
# SPDX-License-Identifier: MIT

config BOARD_CORNHOLIUS_A
	bool "cornholius rev A"
	depends on SOC_NRF52840_QIAA
```

## config/boards/arm/isometria75_rev2/Kconfig.board
```kconfig
# Copyright (c) 2020 The ZMK Contributors
# SPDX-License-Identifier: MIT

config BOARD_ISOMETRIA75_REV2
	bool "isometria75 Keyboard"
	depends on SOC_NRF52840_QIAA
```

## config/boards/arm/osprey/Kconfig.board
```kconfig
# Copyright (c) 2020 The ZMK Contributors
# SPDX-License-Identifier: MIT

config BOARD_OSPREY_A
	bool "osprey rev A"
	depends on SOC_NRF52840_QIAA
```

## config/boards/arm/wlpad/Kconfig.board
```kconfig
# Copyright (c) 2020 The ZMK Contributors
# SPDX-License-Identifier: MIT

config BOARD_WLPAD
	bool "wlpad"
	depends on SOC_NRF52840_QIAA
```

## config/boards/arm/wlpad_a/Kconfig.board
```kconfig
# Copyright (c) 2020 The ZMK Contributors
# SPDX-License-Identifier: MIT

config BOARD_WLPAD_A
	bool "wlpad rev A"
	depends on SOC_NRF52840_QIAA
```

## config/boards/arm/wlpad_a/Kconfig.defconfig
```kconfig
# Copyright (c) 2020 The ZMK Contributors
# SPDX-License-Identifier: MIT

if BOARD_WLPAD_A

config ZMK_KEYBOARD_NAME
	default "wlpad"

if USB

config USB_NRFX
	default y

config USB_DEVICE_STACK
	default y

endif # USB

config BT_CTLR
	default BT

config ZMK_BLE
	default y

config ZMK_USB
	default y

config I2C
	default y

config MAX17048
	default y

endif # BOARD_WLPAD_A
```

## config/osprey/Kconfig.defconfig
```kconfig
# Copyright (c) 2020 The ZMK Contributors
# SPDX-License-Identifier: MIT

if BOARD_OSPREY_A

config ZMK_KEYBOARD_NAME
	default "osprey"

if USB_DEVICE_STACK

config USB_NRFX
	default y

endif # USB_DEVICE_STACK

config BT_CTLR
	default BT

config ZMK_BLE
	default y

config ZMK_USB
	default y

config I2C
	default y

config max17048
	default y

endif # BOARD_OSPREY_A
```
